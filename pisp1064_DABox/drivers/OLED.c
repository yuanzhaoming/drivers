/*********************copyright wit_yuan qj 2016-10-09*********************/
#include "oled.h"
#include <stm32f10x.h>
#include "rtconfig.h"

static void SPI_OLED_SendByte(unsigned char data); 

const unsigned char oled_asc2_8x16[95][16]=
{
    {0x00,0x00,0x00,0x00,0x00,0x00,0x00,0x00,0x00,0x00,0x00,0x00,0x00,0x00,0x00,0x00},// 0
    {0x00,0x00,0x00,0xF8,0x00,0x00,0x00,0x00,0x00,0x00,0x00,0x33,0x30,0x00,0x00,0x00},//!1
    {0x00,0x10,0x0C,0x06,0x10,0x0C,0x06,0x00,0x00,0x00,0x00,0x00,0x00,0x00,0x00,0x00},//"2
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    {0x00,0x06,0x01,0x01,0x02,0x02,0x04,0x04,0x00,0x00,0x00,0x00,0x00,0x00,0x00,0x00},//~94
};

const unsigned char F6x8[][6] =
{
    0x00, 0x00, 0x00, 0x00, 0x00, 0x00,// sp
    0x00, 0x00, 0x00, 0x2f, 0x00, 0x00,// !
    0x00, 0x00, 0x07, 0x00, 0x07, 0x00,// "
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    0x14, 0x14, 0x14, 0x14, 0x14, 0x14,// horiz lines
};

const unsigned char F8X16[]=      
{
  0x00,0x00,0x00,0x00,0x00,0x00,0x00,0x00,0x00,0x00,0x00,0x00,0x00,0x00,0x00,0x00,// 0
  0x00,0x00,0x00,0xF8,0x00,0x00,0x00,0x00,0x00,0x00,0x00,0x33,0x30,0x00,0x00,0x00,//! 1
  0x00,0x10,0x0C,0x06,0x10,0x0C,0x06,0x00,0x00,0x00,0x00,0x00,0x00,0x00,0x00,0x00,//" 2
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  0x00,0x06,0x01,0x01,0x02,0x02,0x04,0x04,0x00,0x00,0x00,0x00,0x00,0x00,0x00,0x00,//~ 94
};

#define DC_DELAY   1
 
static void spi_udelay(unsigned int time)
{
 
	int i = 0;
	unsigned int j;
	for(i = 0 ; i < 8 ; i ++)
	{
	  	for(j = 0 ; j < time; j ++)
			__nop();
	}
}



/*
* 		执行与OLED沟通的指令
*		硬件接线:	
*				PA15/SPI3_NSS	OLED_CS
*				PB03/SPI3_SCK	OLED_SCK
*				PB04/SPI3_MISO	OLED_MISO
*				PB05/SPI3_MOSI	OLED_MOSI
*
*				PB09            OLED_D/C
*               PB08            OLED_RST
*/
/*******************************************************************************
*******************************************************************************/
void SPI_OLED_Init(void)
{
	SPI_InitTypeDef  SPI_InitStructure;
	GPIO_InitTypeDef GPIO_InitStructure;					 
	RCC_APB2PeriphClockCmd(RCC_APB2Periph_GPIOA | RCC_APB2Periph_GPIOB | RCC_APB2Periph_AFIO , ENABLE);
	RCC_APB1PeriphClockCmd(RCC_APB1Periph_SPI3, ENABLE);	
	GPIO_PinRemapConfig( GPIO_Remap_SWJ_JTAGDisable, ENABLE);
	
 	 
	/*!< Configure SPI_FLASH_SPI pins: SCK */
	GPIO_InitStructure.GPIO_Pin = GPIO_Pin_3;
	GPIO_InitStructure.GPIO_Speed = GPIO_Speed_50MHz;
	GPIO_InitStructure.GPIO_Mode = GPIO_Mode_AF_PP;
	GPIO_Init(GPIOB, &GPIO_InitStructure);
	/*!< Configure SPI_FLASH_SPI pins: MISO */
	GPIO_InitStructure.GPIO_Mode = GPIO_Mode_IN_FLOATING;
	GPIO_InitStructure.GPIO_Pin = GPIO_Pin_4;
	GPIO_Init(GPIOB, &GPIO_InitStructure);
	/*!< Configure SPI_FLASH_SPI pins: MOSI */
	GPIO_InitStructure.GPIO_Pin = GPIO_Pin_5;
	GPIO_InitStructure.GPIO_Speed = GPIO_Speed_50MHz;
	GPIO_InitStructure.GPIO_Mode = GPIO_Mode_AF_PP;
	GPIO_Init(GPIOB, &GPIO_InitStructure);
	
	/*!< Configure SPI_FLASH_SPI_CS_PIN pin: Card CS pin */
	GPIO_InitStructure.GPIO_Pin = GPIO_Pin_15;
	GPIO_InitStructure.GPIO_Mode = GPIO_Mode_Out_PP;
	GPIO_InitStructure.GPIO_Speed = GPIO_Speed_50MHz;
	GPIO_Init(GPIOA, &GPIO_InitStructure);
	/* Deselect the FLASH: Chip Select high */
	SPI_OLED_CS_HIGH();
	/* SPI1 configuration */
	SPI_InitStructure.SPI_Direction = SPI_Direction_2Lines_FullDuplex;
	SPI_InitStructure.SPI_Mode = SPI_Mode_Master;
	SPI_InitStructure.SPI_DataSize = SPI_DataSize_8b;
	SPI_InitStructure.SPI_CPOL = SPI_CPOL_High;
	SPI_InitStructure.SPI_CPHA = SPI_CPHA_1Edge;
	SPI_InitStructure.SPI_NSS = SPI_NSS_Soft;
	SPI_InitStructure.SPI_BaudRatePrescaler = SPI_BaudRatePrescaler_32;
	SPI_InitStructure.SPI_FirstBit = SPI_FirstBit_MSB;
	SPI_InitStructure.SPI_CRCPolynomial = 7;
	SPI_Init(SPI3, &SPI_InitStructure);
	/* Enable SPI3  */
	SPI_Cmd(SPI3, ENABLE);
 
	/*
	*   PB08            OLED_RST
	*/
	GPIO_InitStructure.GPIO_Pin = GPIO_Pin_8;
	GPIO_InitStructure.GPIO_Speed = GPIO_Speed_50MHz;
	GPIO_InitStructure.GPIO_Mode = GPIO_Mode_Out_PP;
	GPIO_Init(GPIOB, &GPIO_InitStructure);

	OLED_RST_LOW();
	spi_udelay(1000);
	OLED_RST_HIGH();
	spi_udelay(1000);
	/*
	*   PB09            OLED_DC
	*/
	GPIO_InitStructure.GPIO_Pin = GPIO_Pin_9;
	GPIO_InitStructure.GPIO_Speed = GPIO_Speed_50MHz;
	GPIO_InitStructure.GPIO_Mode = GPIO_Mode_Out_PP;
	GPIO_Init(GPIOB, &GPIO_InitStructure);
}


void OLED_WriteCmd(unsigned char cmd)
{
#if DC_DELAY
	 spi_udelay(2);
#endif
    OLED_DC_LOW( ); /* command */
#if DC_DELAY
	 spi_udelay(2);
#endif
	SPI_OLED_SendByte(cmd);
#if DC_DELAY
	 spi_udelay(2);
#endif	 
    OLED_DC_HIGH();
#if DC_DELAY
	 spi_udelay(2);
#endif
}

static void OLEDWriteDat(unsigned char dat)
{
#if DC_DELAY
	 spi_udelay(2);
#endif
    OLED_DC_HIGH(); /* data */
#if DC_DELAY
	 spi_udelay(2);
#endif
	SPI_OLED_SendByte(dat);
#if DC_DELAY
	 spi_udelay(2);
#endif
    OLED_DC_HIGH(); /*  */
#if DC_DELAY
	 spi_udelay(2);
#endif
}


void WriteDat(unsigned char dat) 
{
#if DC_DELAY
	 spi_udelay(2);
#endif
    OLED_DC_HIGH(); /* data */
#if DC_DELAY
	 spi_udelay(2);
#endif
	SPI_OLED_SendByte(dat);
#if DC_DELAY
	 spi_udelay(2);
#endif
    OLED_DC_HIGH(); /*  */
#if DC_DELAY
	 spi_udelay(2);
#endif
}



static void OLEDSetPageAddrMode(void)
{
	/*set memory addressing mode*/
    OLED_WriteCmd(0x20);
	/*set page addressing mode*/
    OLED_WriteCmd(0x02);
}

static void OLEDSetPos(int page, int col)
{
    OLED_WriteCmd(0xB0 + page); 		/* page address */
    //OLED_WriteCmd(col & 0xf);   		/* Lower Column Start Address */
    //OLED_WriteCmd(0x10 + (col >> 4));   /* Lower Higher Start Address */

	OLED_WriteCmd(((col&0xf0)>>4)|0x10);
	OLED_WriteCmd((col&0x0f)|0x01);
}


void OLED_SetPos(unsigned char x, unsigned char y) 
{ 
	OLED_WriteCmd(0xb0+y);
	OLED_WriteCmd(((x&0xf0)>>4)|0x10);
	OLED_WriteCmd((x&0x0f)|0x01);
}


static void OLEDClear(void)
{
    int page, i;
    for (page = 0; page < 8; page ++)
    {
        OLEDSetPos(page, 0);
        for (i = 0; i < 128; i++)
            OLEDWriteDat(0);
    }
}

void OLED_ON(void)
{
    OLED_WriteCmd(0X8D);  //设置电荷泵
    OLED_WriteCmd(0X14);  //开启电荷泵
    OLED_WriteCmd(0XAF);  //OLED唤醒
}

void OLED_Init(void)
{
	SPI_OLED_Init();
    /* 向OLED发命令以初始化 */
#if 0
    OLED_WriteCmd(DISP_OFF); /*display off*/ 
    OLED_WriteCmd(0x00); /*set lower column address*/ 
    OLED_WriteCmd(0x10); /*set higher column address*/ 
    OLED_WriteCmd(0x40); /*set display start line*/ 
    OLED_WriteCmd(0xB0); /*set page address*/ 

    OLED_WriteCmd(0x81); /*contract control*/ 
    OLED_WriteCmd(0x66); /*128*/ 

    OLED_WriteCmd(0xA1); /*set segment remap*/ 
    OLED_WriteCmd(0xA6); /*normal / reverse*/ 

    OLED_WriteCmd(0xA8); /*multiplex ratio*/ 
    OLED_WriteCmd(0x3F); /*duty = 1/64*/ 

    OLED_WriteCmd(0xC8); /*Com scan direction*//*remap mode,scan from com[N-1] to com0*/ 

    OLED_WriteCmd(0xD3); /*set display offset*/ 
    OLED_WriteCmd(0x00); 

    OLED_WriteCmd(0xD5); /*set osc division*/ 
    OLED_WriteCmd(0x80); 

    OLED_WriteCmd(0xD9); /*set pre-charge period*/ 
    OLED_WriteCmd(0x1f); 

    OLED_WriteCmd(0xDA); /*set COM pins*/ /*0x12 disable com left/right remap.alternative com pin configuration*/
    OLED_WriteCmd(0x12); 

    OLED_WriteCmd(0xdb); /*set vcomh*/ 
    OLED_WriteCmd(0x30); 

    OLED_WriteCmd(0x8d); /*set charge pump enable*/ 
    OLED_WriteCmd(0x14); 	

    OLEDSetPageAddrMode();
    OLEDClear();
    OLED_WriteCmd(DISP_ON); /*display ON*/ 
#else
	OLED_WriteCmd(0xAE); //display off
	OLED_WriteCmd(0x20); //Set Memory Addressing Mode    
	OLED_WriteCmd(0x10); //00,Horizontal Addressing Mode;01,Vertical Addressing Mode;10,Page Addressing Mode (RESET);11,Invalid
	OLED_WriteCmd(0xb0); //Set Page Start Address for Page Addressing Mode,0-7
	OLED_WriteCmd(0xc8); //Set COM Output Scan Direction
	OLED_WriteCmd(0x00); //---set low column address
	OLED_WriteCmd(0x10); //---set high column address
	OLED_WriteCmd(0x40); //--set start line address
	OLED_WriteCmd(0x81); //--set contrast control register
	OLED_WriteCmd(0xff); //???? 0x00~0xff
	OLED_WriteCmd(0xa1); //--set segment re-map 0 to 127
	OLED_WriteCmd(0xa6); //--set normal display
	OLED_WriteCmd(0xa8); //--set multiplex ratio(1 to 64)
	OLED_WriteCmd(0x3F); //
	OLED_WriteCmd(0xa4); //0xa4,Output follows RAM content;0xa5,Output ignores RAM content
	OLED_WriteCmd(0xd3); //-set display offset
	OLED_WriteCmd(0x00); //-not offset
	OLED_WriteCmd(0xd5); //--set display clock divide ratio/oscillator frequency
	OLED_WriteCmd(0xf0); //--set divide ratio
	OLED_WriteCmd(0xd9); //--set pre-charge period
	OLED_WriteCmd(0x22); //
	OLED_WriteCmd(0xda); //--set com pins hardware configuration
	OLED_WriteCmd(0x12);
	OLED_WriteCmd(0xdb); //--set vcomh
	OLED_WriteCmd(0x20); //0x20,0.77xVcc
	OLED_WriteCmd(0x8d); //--set DC-DC enable
	OLED_WriteCmd(0x14); //
	OLED_WriteCmd(0xaf); //--turn on oled panel
	OLEDClear();


	OLED_ON();

#endif
}


/* page: 0-7
 * col : 0-127
 * 字符: 8x16象素
 */
void OLEDPutChar(int page, int col, char c)
{
    int i = 0;
    /* 得到字模 */
    const unsigned char *dots = oled_asc2_8x16[c - ' '];

    /* 发给OLED */
    OLEDSetPos(page, col);
    /* 发出8字节数据 */
    for (i = 0; i < 8; i++)
        OLEDWriteDat(dots[i]);

    OLEDSetPos(page+1, col);
    /* 发出8字节数据 */
    for (i = 0; i < 8; i++)
        OLEDWriteDat(dots[i+8]);

}


/*
* 	stm32硬件spi发送数据
*
*
*/
unsigned char hal_SPI_OLED_SendByte(unsigned char byte)
{
	/* Loop while DR register in not emplty */
	while (SPI_I2S_GetFlagStatus(SPI3, SPI_I2S_FLAG_TXE) == RESET);
	/* Send byte through the SPI1 peripheral */
	SPI_I2S_SendData(SPI3, byte);
	/* Wait to receive a byte */
	while (SPI_I2S_GetFlagStatus(SPI3, SPI_I2S_FLAG_RXNE) == RESET);
	/* Return the byte read from the SPI bus */
	return SPI_I2S_ReceiveData(SPI3);
}

/*
* 		读取OLED传输过来的32位的数据，采用轮询方式
*
*/
u32 SPI_OLED_ReadByte(void)
{
	unsigned int c_rcv1;
	unsigned int c_rcv2;
	unsigned int c_rcv3;
	unsigned int c_rcv4;

	SPI_OLED_CS_LOW();

	c_rcv1 = hal_SPI_OLED_SendByte(0xff); 
	c_rcv2 = hal_SPI_OLED_SendByte(0xff); 
	c_rcv3 = hal_SPI_OLED_SendByte(0xff); 
	c_rcv4 = hal_SPI_OLED_SendByte(0xff); 

	SPI_OLED_CS_HIGH();
  	return (c_rcv1 << 24) | (c_rcv2 << 16 ) | (c_rcv3 << 8) | c_rcv4;
}

/*
*
*
*  	 使用硬件spi给stm32发送数据
*
*/
static void SPI_OLED_SendByte(unsigned char data)
{
	int i = 0;
	unsigned char c_value;
  	SPI_OLED_CS_LOW();
	c_value = hal_SPI_OLED_SendByte(data);
	SPI_OLED_CS_HIGH();
}

 
/* page: 0-7
 * col : 0-127
 * 字符: 8x16象素
 */
void OLED_Print(int page, int col, char *str)
{
    int i = 0;
    while (str[i])
    {
        OLEDPutChar(page, col, str[i]);
        col += 8;
        if (col > 126)
        {
            col = 0;
            page += 2;
        }
        i++;
    }
}



void OLED_ShowStr(unsigned char x, unsigned char y, unsigned char ch[], unsigned char TextSize)
{
	unsigned char c = 0,i = 0,j = 0;
	switch(TextSize)
	{
		case 1:
		{
			while(ch[j] != '\0')
			{
				c = ch[j] - 32;
				if(x > 126)
				{
					x = 0;
					y++;
				}
				OLED_SetPos(x,y);
				for(i=0;i<6;i++)
					WriteDat(F6x8[c][i]);
				x += 6;
				j++;
			}
		}break;
		case 2:
		{
			while(ch[j] != '\0')
			{
				c = ch[j] - 32;
				if(x > 120)
				{
						x = 0;
						y++;
				}
				OLED_SetPos(x,y);
				for(i=0;i<8;i++)
						WriteDat(F8X16[c*16+i]);
				OLED_SetPos(x,y+1);
				for(i=0;i<8;i++)
						WriteDat(F8X16[c*16+i+8]);
				x += 8;
				j++;
			}
		}break;
	}
}
















/****************************end of file*********************************/

